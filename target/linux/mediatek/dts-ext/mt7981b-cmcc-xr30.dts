// SPDX-License-Identifier: GPL-2.0-or-later OR MIT
/*
 * Copyright (C) 2023 Tianling Shen <cnsztl@immortalwrt.org>
 */

/dts-v1/;
#include "mt7981b-cmcc-xr30.dtsi"

/ {
	model = "CMCC XR30";
	compatible = "cmcc,xr30", "mediatek,mt7981";
};

@spi_nand {
	mediatek,nmbm;
	mediatek,bmt-max-ratio = <1>;
	mediatek,bmt-max-reserved-blocks = <64>;
}

@partitions {
	partition@580000 {
		label = "ubi";
		reg = <0x580000 0x7200000>;
	};
}